## conf/distro/openinkpot.conf
```bitbake
require conf/distro/poky-tiny.conf
DISTRO = "openinkpot"
IMAGE_FSTYPES = "${OI_IMAGE_FSTYPES}"
IMAGE_FSTYPES_qemuall += "ext3"

# ipv6 -- required by glib2
# xattr -- required by buggy rsync
# libc-locale-code,libc-posix-wchar-io,libc-posix-clang-wchar -- required by util-linux
# libc-backtrace -- required by weston to use backtrace() for libunwind replacement
# libc-spawn -- required by gettext
DISTRO_FEATURES = "usbgadget wifi ipv6 xattr libc-locale-code libc-spawn \
		   libc-posix-wchar-io libc-posix-clang-wchar libc-backtrace \
		   ${DISTRO_FEATURES_NET} ${DISTRO_FEATURES_LIBC}"
DISTRO_FEATURES_BACKFILL_CONSIDERED = "sysvinit pulseaudio"
VIRTUAL-RUNTIME_init_manager = "procd"
VIRTUAL-RUNTIME_dev_manager = ""
VIRTUAL-RUNTIME_initscripts = ""
PACKAGECONFIG_pn-weston = "fbdev"
```

## conf/machine/eb600.conf
```bitbake
#@TYPE: Machine
#@NAME: eb600

#@DESCRIPTION: configuration for Netronix EB600 based systems

ARM_INSTRUCTION_SET = "arm"
require conf/machine/include/tune-arm920t.inc
TUNE_FEATURES_tune-armv4_append = " arm920t no-thumb-interwork"

IMAGE_FSTYPES += "ext3"
SERIAL_CONSOLE = "115200 ttySAC0"
KERNEL_IMAGETYPE = "uImage"
MACHINE_FEATURES = "apm usbgadget usbhost vfat alsa rtc"
```

## conf/machine/include/imx-base.inc
```bitbake
include conf/machine/include/soc-family.inc
SERIAL_CONSOLE = "115200 ttymxc0"
PREFERRED_PROVIDER_virtual/kernel = "linux-openinkpot"
```

## conf/machine/include/imx50.inc
```bitbake
include conf/machine/include/imx-base.inc
include conf/machine/include/tune-cortexa8.inc

SOC_FAMILY = "mx:mx50"
```

## conf/machine/kindle4.conf
```bitbake
#@TYPE: Machine
#@NAME: Amazon Kindle 4 eBook Reader
#@SOC: i.MX508
#@DESCRIPTION: Machine configuration for Amazon Kindle 4 eReader (4-th generation)
#@MAINTAINER: Sergiy Kibrik <sakib@darkstar.site>

include conf/machine/include/imx50.inc

#TODO: build kernel
KERNEL_DEVICETREE = ""
KERNEL_IMAGETYPE = "zImage"

#TODO: anything to append?
TUNE_FEATURES_tune-armv4_append = ""

#TODO: cpio ?
IMAGE_FSTYPES += ""

#TODO: what's needed here?
#MACHINE_FEATURES = "apm usbgadget usbhost vfat alsa rtc"
```
